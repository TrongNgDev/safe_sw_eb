## esp32c6/esp32c6_wamr_AOT_C/sdkconfig.defaults
```kconfig
CONFIG_COMPILER_OPTIMIZATION_PERF=y

#
# Memory protection
#
# CONFIG_ESP_SYSTEM_PMP_IDRAM_SPLIT is not set
# end of Memory protection

#
# WASM Micro Runtime
#
CONFIG_WAMR_BUILD_RELEASE=y
# CONFIG_WAMR_BUILD_DEBUG is not set
CONFIG_WAMR_ENABLE_AOT=y
# CONFIG_WAMR_ENABLE_INTERP is not set
# CONFIG_WAMR_INTERP_CLASSIC is not set
# CONFIG_WAMR_INTERP_FAST is not set
# CONFIG_WAMR_INTERP_LOADER_NORMAL is not set
# CONFIG_WAMR_INTERP_LOADER_MINI is not set
# CONFIG_WAMR_ENABLE_LIB_PTHREAD is not set
CONFIG_WAMR_ENABLE_LIBC_BUILTIN=y
# CONFIG_WAMR_ENABLE_LIBC_WASI is not set
# CONFIG_WAMR_ENABLE_MEMORY_PROFILING is not set
# CONFIG_WAMR_ENABLE_MULTI_MODULE is not set
# CONFIG_WAMR_ENABLE_PERF_PROFILING is not set
CONFIG_WAMR_ENABLE_REF_TYPES=y
# CONFIG_WAMR_ENABLE_SHARED_MEMORY is not set
# end of WASM Micro Runtime
```

## esp32c6/esp32c6_wamr_interp_fast_Rust/sdkconfig.defaults
```kconfig
CONFIG_COMPILER_OPTIMIZATION_PERF=y

#
# WASM Micro Runtime
#
CONFIG_WAMR_BUILD_RELEASE=y
# CONFIG_WAMR_BUILD_DEBUG is not set
# CONFIG_WAMR_ENABLE_AOT is not set
CONFIG_WAMR_ENABLE_INTERP=y
# CONFIG_WAMR_INTERP_CLASSIC is not set
CONFIG_WAMR_INTERP_FAST=y
CONFIG_WAMR_INTERP_LOADER_NORMAL=y
# CONFIG_WAMR_INTERP_LOADER_MINI is not set
# CONFIG_WAMR_ENABLE_LIB_PTHREAD is not set
CONFIG_WAMR_ENABLE_LIBC_BUILTIN=y
# CONFIG_WAMR_ENABLE_LIBC_WASI is not set
# CONFIG_WAMR_ENABLE_MEMORY_PROFILING is not set
# CONFIG_WAMR_ENABLE_MULTI_MODULE is not set
# CONFIG_WAMR_ENABLE_PERF_PROFILING is not set
CONFIG_WAMR_ENABLE_REF_TYPES=y
# CONFIG_WAMR_ENABLE_SHARED_MEMORY is not set
# end of WASM Micro Runtime
```
